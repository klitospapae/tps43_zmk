## Kconfig
```kconfig
config INPUT_TPS43
	bool "Azoteq TPS43 capacitive track-pad"
	depends on GPIO && I2C && INPUT && ZMK_POINTING
	default y
	help
	  Enable the TPS43 touch-pad driver for ZMK.
```

## dts/bindings/input/azoteq,tps43.yaml
```yaml
description: Azoteq TPS43 capacitive touch-pad

compatible: "azoteq,tps43"

include: ["i2c-device.yaml"]

properties:
  int-gpios:
    type: phandle-array
    description: Ready/DRDY interrupt (active low)

  reset-gpios:
    type: phandle-array
    description: Chip reset (active low)

  azoteq,max-xy:
    type: array
    required: false
    description: Maximum X and Y raw values from the pad
```
